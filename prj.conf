## CMakeLists.txt
```
cmake_minimum_required(VERSION 3.20.0)
find_package(Zephyr REQUIRED HINTS $ENV{ZEPHYR_BASE})
project(zephyr_teensy_app)

# Add your source file to the "app" target. This must come after
# find_package(Zephyr) which defines the target.
target_sources(app PRIVATE src/main.c)
#target_sources(app PRIVATE src/led.c)
#target_sources(app PRIVATE src/pin.c)
#target_sources(app PRIVATE src/button.c)
#target_sources(app PRIVATE src/uart.c)
#target_sources(app PRIVATE src/spi.c)
target_sources(app PRIVATE src/sdhc.c)
#target_sources(app PRIVATE src/dhcp.c)
#target_sources(app PRIVATE src/valves.c)
#target_sources(app PRIVATE src/relays.c)

include_directories(${CMAKE_CURRENT_SOURCE_DIR}/src)

zephyr_code_relocate(src/*.c DTCM_DATA)
zephyr_code_relocate(src/*.c ITCM_TEXT)
```

## Kconfig
```
# Copyright (c) 2019 Nordic Semiconductor ASA
# SPDX-License-Identifier: Apache-2.0

config USB_DEVICE_PID
	default USB_PID_CONSOLE_SAMPLE

config LOG_BACKEND_UART
    bool "Enable UART backend"
    default y if !SHELL_BACKEND_SERIAL
    depends on UART_CONSOLE && !LOG_MINIMAL && LOG
    help
      When enabled backend is using UART to output logs.

source "Kconfig.zephyr"
```

## prj.conf
```kconfig
# GENERAL
CONFIG_CODE_DATA_RELOCATION=y
CONFIG_LOG=y
CONFIG_GPIO=y

CONFIG_SHELL=y

# SDHC
CONFIG_FILE_SYSTEM=y
CONFIG_FAT_FILESYSTEM_ELM=y
CONFIG_FS_FATFS_EXFAT=y
CONFIG_FS_FATFS_MOUNT_MKFS=y
CONFIG_SDMMC_USDHC=y
CONFIG_DISK_DRIVER_SDMMC=y
CONFIG_SDMMC_LOG_LEVEL_DBG=y
CONFIG_FILE_SYSTEM_SHELL=y
CONFIG_HEAP_MEM_POOL_SIZE=32768

# USB
CONFIG_USB_DEVICE_STACK=y
#CONFIG_USB_UART_CONSOLE=y NOT necessary from Zephyr 3.0.0 onwards
CONFIG_USB_DRIVER_LOG_LEVEL_ERR=y
CONFIG_USB_DEVICE_PRODUCT="TEENSY USB CONSOLE"
CONFIG_USB_DEVICE_VID=0x2FE4
CONFIG_UART_INTERRUPT_DRIVEN=y
CONFIG_UART_LINE_CTRL=y

CONFIG_SERIAL=y
CONFIG_CONSOLE=y
CONFIG_UART_CONSOLE=y
CONFIG_UART_LINE_CTRL=y

# ETH
CONFIG_NETWORKING=y
CONFIG_NET_IPV6=n
CONFIG_NET_IPV4=y
CONFIG_NET_DHCPV4=y

CONFIG_NET_MGMT=y
CONFIG_NET_MGMT_EVENT=y

# SPI
CONFIG_SPI=y
```

## boards/teensy41.overlay
```dts
/ {
	chosen {
		zephyr,console = &cdc_acm_uart0;
        zephyr,shell-uart = &cdc_acm_uart0;
	};
};

&zephyr_udc0 {
	cdc_acm_uart0: cdc_acm_uart0 {
		compatible = "zephyr,cdc-acm-uart";
		label = "CDC_ACM_0";
	};
};
```

## src/main.c
```c
/**
 * @file main.c
 * @author Bob Peters
 * @brief Application startup
 * @date 2022-02-09
 * 
 * @copyright Copyright (c) 2022 EmbedWise
 * 
 */

#include <zephyr.h>
#include <logging/log.h>

#include <usb/usb_device.h>


#define START_DELAY 2000


LOG_MODULE_REGISTER(main, LOG_LEVEL_DBG);


void main(void)
{
	uint32_t version = sys_kernel_version_get();

	if (usb_enable(NULL)) {
		return;
	}

	k_msleep(START_DELAY);

	LOG_INF("Started zephyr %u.%u.%u on board %s/%s.", SYS_KERNEL_VER_MAJOR(version), SYS_KERNEL_VER_MINOR(version), SYS_KERNEL_VER_PATCHLEVEL(version), CONFIG_ARCH, CONFIG_BOARD);
}
```

## src/sdhc.c
```c
/**
 * @file sdhc.c
 * @author Bob Peters 
 * @brief Verify if SDCARD can be detected
 * @date 2022-02-09
 * 
 * @copyright Copyright (c) 2022 EmbedWise
 * 
 */

#include <zephyr.h>
#include <logging/log.h>

#include <storage/disk_access.h>
#include <fs/fs.h>
#include <ff.h>

#define LOG_MODULE_NAME sdhc

#define START_DELAY     5000
#define STACK_SIZE      2000
#define PRIORITY        5

static int lsdir(const char *path);

static FATFS fat_fs;
/* mounting info */
static struct fs_mount_t mp = {
	.type = FS_FATFS,
	.fs_data = &fat_fs,
};

/*
*  Note the fatfs library is able to mount only strings inside _VOLUME_STRS
*  in ffconf.h
*/
static const char *disk_mount_pt = "/SD:";

void sdhc_main_f();
static int lsdir(const char *path);

LOG_MODULE_REGISTER(LOG_MODULE_NAME, LOG_LEVEL_DBG);

K_THREAD_DEFINE(sdhc_id, STACK_SIZE, sdhc_main_f, NULL, NULL, NULL,
                PRIORITY, 0, START_DELAY);


void sdhc_main_f()
{
    /* raw disk i/o */
	do {
		static const char *disk_pdrv = "SD";
		uint64_t memory_size_mb;
		uint32_t block_count;
		uint32_t block_size;

		if (disk_access_init(disk_pdrv) != 0) {
			LOG_ERR("Storage init ERROR!");
			return;
		}

		if (disk_access_ioctl(disk_pdrv,
				DISK_IOCTL_GET_SECTOR_COUNT, &block_count)) {
			LOG_ERR("Unable to get sector count");
			return;
		}
		LOG_INF("Block count %u", block_count);

		if (disk_access_ioctl(disk_pdrv,
				DISK_IOCTL_GET_SECTOR_SIZE, &block_size)) {
			LOG_ERR("Unable to get sector size");
			return;
		}
		LOG_INF("Sector size %u", block_size);

		memory_size_mb = (uint64_t)block_count * block_size;
		LOG_INF("Memory Size(MB) %u", (uint32_t)(memory_size_mb >> 20));
	} while (0);

	mp.mnt_point = disk_mount_pt;

	int res = fs_mount(&mp);

	if (res == FR_OK) {
		LOG_INF("Disk mounted.");
		lsdir(disk_mount_pt);
	} else {
		LOG_INF("Error mounting disk.");
	}
}

static int lsdir(const char *path)
{
	int res;
	struct fs_dir_t dirp;
	static struct fs_dirent entry;

	/* Verify fs_opendir() */
	res = fs_opendir(&dirp, path);
	if (res) {
		LOG_INF("Error opening dir %s [%d]", path, res);
		return res;
	}

	LOG_INF("Listing dir %s ...", path);
	for (;;) 
    {
		/* Verify fs_readdir() */
		res = fs_readdir(&dirp, &entry);

		/* entry.name[0] == 0 means end-of-dir */
		if (res || entry.name[0] == 0) {
			break;
		}

		if (entry.type == FS_DIR_ENTRY_DIR) {
			LOG_INF("[DIR] %s", log_strdup(entry.name));
		} else {
			LOG_INF("[FILE] %s", log_strdup(entry.name));
		}
	}

	/* Verify fs_closedir() */
	fs_closedir(&dirp);

	return res;
}
```
